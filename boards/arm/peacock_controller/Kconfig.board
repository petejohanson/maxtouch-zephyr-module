## boards/arm/peacock_controller/Kconfig.board
```kconfig
# Copyright (c) 2023 The ZMK Contributors
# SPDX-License-Identifier: Apache-2.0

config BOARD_PEACOCK_CONTROLLER
    bool "Peacock Controller"
    depends on SOC_RP2040
```

## boards/arm/peacock_controller/Kconfig.defconfig
```kconfig
# Copyright (c) 2023 The ZMK Contributors
# SPDX-License-Identifier: MIT

if BOARD_PEACOCK_CONTROLLER

config ZMK_KEYBOARD_NAME
    default "Peacock"

config RP2_FLASH_W25Q080
    default y

endif # BOARD_PEACOCK_CONTROLLER
```

## boards/shields/peacock_vik_module/Kconfig.defconfig
```kconfig
# Copyright (c) 2019 Linaro Limited
# SPDX-License-Identifier: Apache-2.0

if SHIELD_PEACOCK_VIK_MODULE

config ZMK_TRACKPAD_LOGICAL_X
	default 3685

config ZMK_TRACKPAD_LOGICAL_Y
	default 2150

config ZMK_TRACKPAD_PHYSICAL_X
	default 1560

config ZMK_TRACKPAD_PHYSICAL_Y
	default 910

endif # SHIELD_PEACOCK_VIK_MODULE
```

## boards/shields/peacock_vik_module/Kconfig.shield
```kconfig
# Copyright (c) 2024 Pete Johanson
# SPDX-License-Identifier: MIT

config SHIELD_PEACOCK_VIK_MODULE
	def_bool $(shields_list_contains,peacock_vik_module)
	imply ZMK_MOUSE
	imply ZMK_TRACKPAD
	select I2C
```

## drivers/input/Kconfig
```kconfig
# Copyright (c) 2024 The ZMK Contributors
# SPDX-License-Identifier: MIT

menuconfig INPUT_MICROCHIP_MAXTOUCH
    bool "Microchip maXTouch trackpads"
    default y
    depends on GPIO
    depends on I2C
    depends on INPUT
    depends on DT_HAS_MICROCHIP_MAXTOUCH_ENABLED
    help
      Enable driver for Microchip maXTouch trackpads
```

## dts/bindings/input/microchip,maxtouch.yaml
```yaml
description: |
  Input driver for Microchip maxTouch devices

include: ["i2c-device.yaml"]

compatible: "microchip,maxtouch"

properties:
  chg-gpios:
    type: phandle-array
    description: CHG pin for the device
    required: true
  max-touch-points:
    type: int
    default: 5
  repeat-each-cycle:
    type: boolean
    description: Repeat events for any active touches each scan, even if no changes detected.
  swap-xy:
    type: boolean
  invert-x:
    type: boolean
  invert-y:
    type: boolean
  idle-acq-time-ms:
    type: int
    default: 32
  active-acq-time-ms:
    type: int
    default: 10
  active-to-idle-timeout-ms:
    type: int
    default: 50
```
