// Copyright (c) 2023 The ZMK Contributors
// SPDX-License-Identifier: MIT

#include <behaviors.dtsi>
#include <dt-bindings/zmk/keys.h>


/ {
    keymap {
        compatible = "zmk,keymap";

        base {
            bindings = <
&kp N1  &bootloader  &kp N3  &kp N4  &kp N5  &kp N6  &kp N7
            >;
        };
    };
};
