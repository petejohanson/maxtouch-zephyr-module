/*
 * Copyright (c) 2021 Peter Johanson
 *
 * SPDX-License-Identifier: Apache-2.0
 */

/ {
	vik_conn: vik_connector {
		compatible = "sadekbaroudi,vik-connector";
		#gpio-cells = <2>;
		gpio-map-mask = <0xffffffff 0xffffffc0>;
		gpio-map-pass-thru = <0 0x3f>;
		gpio-map
			= <0 0 &gpio0 10 0>		/* D0 */
			, <1 0 &gpio0 11 0>		/* D1 */
			, <3 0 &gpio0 28 0>		/* D3 */
			, <4 0 &gpio0 3 0>		/* D4 */
			, <5 0 &gpio0 29 0>		/* D5 */
			, <6 0 &gpio0 1 0>		/* D6 */
			, <7 0 &gpio0 0 0>		/* D7 */
			, <8 0 &gpio0 2 0>		/* D8 */
			;
	};
};

vik_i2c: &i2c0 {};
vik_spi: &spi0 {};
