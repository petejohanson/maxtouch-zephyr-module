/*
 * Copyright (c) 2024 Pete Johanson
 *
 * SPDX-License-Identifier: MIT
 */

&vik_i2c {
	status = "okay";

	trackpad: maxtouch@4a {
		compatible = "microchip,maxtouch";
		reg = <0x4a>;
		chg-gpios = <&vik_conn 3 (GPIO_ACTIVE_LOW | GPIO_PULL_UP)>;

		swap-xy;
		repeat-each-cycle;
	};
};

/ {
	trackpad_listener {
		compatible = "zmk,input-listener";

		mode = "trackpad";

		device = <&trackpad>;
	};
};
